// Wingbeat inference on ESP32-CAM — hand-coded CNN1D using model_weights.h
// generated by scripts/export_student_for_esp32.py.
//
// What this firmware does:
//   1) For each of NUM_TEST_SAMPLES embedded test windows:
//        a) Run our 1D-CNN forward pass entirely on-chip.
//        b) Compare argmax against the PyTorch reference (REF_PRED_LABELS).
//        c) Print per-sample timing and logit diff.
//   2) Report pass/fail summary and average inference time.
//
// Upload via:
//   arduino-cli compile --fqbn esp32:esp32:esp32cam firmware/wingbeat_inference
//   arduino-cli upload  --fqbn esp32:esp32:esp32cam --port /dev/cu.usbserial-1120 \
//                       firmware/wingbeat_inference
//
// Then:
//   screen /dev/cu.usbserial-1120 115200

#include "model_weights.h"
#include <math.h>

// ---- working buffers ----------------------------------------------------
// Worst case: 16 channels x 512 samples = 8192 floats = 32 KB.
// Use two ping-pong buffers so we don't blow SRAM unnecessarily.
static float buf_a[16 * 512];
static float buf_b[24 * 256];

// ---- math primitives ----------------------------------------------------

static inline float relu(float x) { return x > 0.0f ? x : 0.0f; }

// 1D convolution with stride 1, symmetric "same" padding (padding = k/2).
// in:        (in_ch, in_len) row-major
// weight:    (out_ch, in_ch, k)
// bias:      (out_ch)
// out:       (out_ch, in_len) row-major  (written by caller's buffer)
static void conv1d_same(const float* in, int in_ch, int in_len,
                        const float* weight, const float* bias,
                        int out_ch, int kernel,
                        float* out) {
  const int pad = kernel / 2;
  for (int oc = 0; oc < out_ch; ++oc) {
    const float b = bias[oc];
    for (int t = 0; t < in_len; ++t) {
      float acc = b;
      for (int ic = 0; ic < in_ch; ++ic) {
        const float* in_row = in + ic * in_len;
        const float* w_row = weight + ((oc * in_ch) + ic) * kernel;
        for (int k = 0; k < kernel; ++k) {
          int in_t = t - pad + k;
          if (in_t >= 0 && in_t < in_len) {
            acc += in_row[in_t] * w_row[k];
          }
        }
      }
      out[oc * in_len + t] = acc;
    }
  }
}

// In-place ReLU on (channels, length).
static void relu_inplace(float* x, int n) {
  for (int i = 0; i < n; ++i) x[i] = relu(x[i]);
}

// MaxPool1D kernel=2 stride=2. in: (channels, in_len). out: (channels, in_len/2).
static void maxpool1d_2(const float* in, int channels, int in_len, float* out) {
  const int out_len = in_len / 2;
  for (int c = 0; c < channels; ++c) {
    const float* in_row = in + c * in_len;
    float* out_row = out + c * out_len;
    for (int t = 0; t < out_len; ++t) {
      float a = in_row[2 * t];
      float b = in_row[2 * t + 1];
      out_row[t] = a > b ? a : b;
    }
  }
}

// AdaptiveAvgPool1d(1): mean over time, channel-wise. Writes `channels` floats.
static void global_avgpool1d(const float* in, int channels, int in_len, float* out) {
  for (int c = 0; c < channels; ++c) {
    const float* row = in + c * in_len;
    double sum = 0.0;
    for (int t = 0; t < in_len; ++t) sum += row[t];
    out[c] = (float)(sum / in_len);
  }
}

// y = W x + b  (W shape: out_dim x in_dim, x shape: in_dim, y shape: out_dim)
static void linear(const float* x, int in_dim,
                   const float* w, const float* b,
                   int out_dim, float* y) {
  for (int o = 0; o < out_dim; ++o) {
    float acc = b[o];
    const float* w_row = w + o * in_dim;
    for (int i = 0; i < in_dim; ++i) acc += w_row[i] * x[i];
    y[o] = acc;
  }
}

static int argmax3(const float* x) {
  int best = 0;
  for (int i = 1; i < 3; ++i) if (x[i] > x[best]) best = i;
  return best;
}

// ---- full forward pass --------------------------------------------------
// input: (MODEL_INPUT_LEN,) float — single window
// out_logits: (MODEL_N_CLASSES,) float
static void forward(const float* input, float* out_logits) {
  // Block 0: (1, 1024) -> conv -> ReLU -> maxpool -> (8, 512)
  // After conv: write into buf_a treating it as (8, 1024) = 8192 floats. ✓ fits.
  conv1d_same(input, 1, MODEL_INPUT_LEN,
              BLOCK0_WEIGHT, BLOCK0_BIAS,
              MODEL_BLOCK0_OUT_CH, MODEL_BLOCK0_KERNEL, buf_a);
  relu_inplace(buf_a, MODEL_BLOCK0_OUT_CH * MODEL_INPUT_LEN);
  maxpool1d_2(buf_a, MODEL_BLOCK0_OUT_CH, MODEL_INPUT_LEN, buf_b);
  // buf_b now holds (8, 512) = 4096 floats.

  // Block 1: (8, 512) -> conv -> ReLU -> maxpool -> (16, 256)
  conv1d_same(buf_b, MODEL_BLOCK1_IN_CH, MODEL_INPUT_LEN / 2,
              BLOCK1_WEIGHT, BLOCK1_BIAS,
              MODEL_BLOCK1_OUT_CH, MODEL_BLOCK1_KERNEL, buf_a);
  // buf_a now (16, 512) = 8192 floats. ✓
  relu_inplace(buf_a, MODEL_BLOCK1_OUT_CH * (MODEL_INPUT_LEN / 2));
  maxpool1d_2(buf_a, MODEL_BLOCK1_OUT_CH, MODEL_INPUT_LEN / 2, buf_b);
  // buf_b now (16, 256) = 4096 floats.

  // Block 2: (16, 256) -> conv -> ReLU -> maxpool -> (24, 128)
  conv1d_same(buf_b, MODEL_BLOCK2_IN_CH, MODEL_INPUT_LEN / 4,
              BLOCK2_WEIGHT, BLOCK2_BIAS,
              MODEL_BLOCK2_OUT_CH, MODEL_BLOCK2_KERNEL, buf_a);
  // buf_a now (24, 256) = 6144 floats. ✓
  relu_inplace(buf_a, MODEL_BLOCK2_OUT_CH * (MODEL_INPUT_LEN / 4));
  maxpool1d_2(buf_a, MODEL_BLOCK2_OUT_CH, MODEL_INPUT_LEN / 4, buf_b);
  // buf_b now (24, 128) = 3072 floats.

  // GAP -> (24,)
  float feat[MODEL_FC1_IN];
  global_avgpool1d(buf_b, MODEL_BLOCK2_OUT_CH, MODEL_INPUT_LEN / 8, feat);

  // FC1 -> ReLU
  float h[MODEL_FC1_OUT];
  linear(feat, MODEL_FC1_IN, FC1_WEIGHT, FC1_BIAS, MODEL_FC1_OUT, h);
  relu_inplace(h, MODEL_FC1_OUT);

  // FC2 -> logits
  linear(h, MODEL_FC2_IN, FC2_WEIGHT, FC2_BIAS, MODEL_FC2_OUT, out_logits);
}

// ---- driver loop --------------------------------------------------------
void setup() {
  Serial.begin(115200);
  delay(500);
  Serial.println();
  Serial.println("=========================================");
  Serial.println("  ESP32 wingbeat inference self-check");
  Serial.printf ("  built %s %s\n", __DATE__, __TIME__);
  Serial.printf ("  model: 1D-CNN student, %d-class\n", MODEL_N_CLASSES);
  Serial.printf ("  input: %d samples per window\n", MODEL_INPUT_LEN);
  Serial.printf ("  free heap at boot: %u bytes\n", ESP.getFreeHeap());
  Serial.println("=========================================");
  Serial.println();
}

void loop() {
  int n_match_pytorch = 0;
  int n_match_true = 0;
  unsigned long total_us = 0;
  float max_logit_diff = 0.0f;

  for (int s = 0; s < NUM_TEST_SAMPLES; ++s) {
    const float* x = &TEST_SAMPLES[s * MODEL_INPUT_LEN];
    float logits[MODEL_N_CLASSES];

    unsigned long t0 = micros();
    forward(x, logits);
    unsigned long dt = micros() - t0;
    total_us += dt;

    int pred = argmax3(logits);
    int ref_pred = REF_PRED_LABELS[s];
    int true_label = TEST_TRUE_LABELS[s];
    if (pred == ref_pred) ++n_match_pytorch;
    if (pred == true_label) ++n_match_true;

    // Max abs diff vs reference logits (sanity check on hand-coded inference).
    float diff = 0.0f;
    for (int c = 0; c < MODEL_N_CLASSES; ++c) {
      float d = fabsf(logits[c] - REF_LOGITS[s * MODEL_N_CLASSES + c]);
      if (d > diff) diff = d;
    }
    if (diff > max_logit_diff) max_logit_diff = diff;

    Serial.printf(
      "sample %d  true=%s  ref_pred=%s  esp_pred=%s  %s  "
      "esp_logits=[%.3f,%.3f,%.3f]  ref_logits=[%.3f,%.3f,%.3f]  "
      "max_diff=%.4f  %lu us\n",
      s,
      MODEL_CLASS_NAMES[true_label],
      MODEL_CLASS_NAMES[ref_pred],
      MODEL_CLASS_NAMES[pred],
      (pred == ref_pred ? "OK" : "MISMATCH"),
      logits[0], logits[1], logits[2],
      REF_LOGITS[s * MODEL_N_CLASSES + 0],
      REF_LOGITS[s * MODEL_N_CLASSES + 1],
      REF_LOGITS[s * MODEL_N_CLASSES + 2],
      diff, dt);
  }

  Serial.println();
  Serial.printf("== summary ==\n");
  Serial.printf("  matches PyTorch reference: %d / %d\n", n_match_pytorch, NUM_TEST_SAMPLES);
  Serial.printf("  matches ground truth:      %d / %d\n", n_match_true,    NUM_TEST_SAMPLES);
  Serial.printf("  max |esp_logit - ref_logit|: %.5f  (should be <0.001)\n", max_logit_diff);
  Serial.printf("  mean inference time:       %lu us / sample\n", total_us / NUM_TEST_SAMPLES);
  Serial.printf("  free heap after run:       %u bytes\n", ESP.getFreeHeap());
  Serial.println();

  delay(10000);  // re-run every 10 s
}
